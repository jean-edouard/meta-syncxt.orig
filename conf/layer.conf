## conf/layer.conf
```bitbake
# We have a conf and classes directory, append to BBPATH
BBPATH .= ":${LAYERDIR}"

# We have a recipes directory, add to BBFILES
BBFILES += " \
    ${LAYERDIR}/recipes-*/*/*.bb \
    ${LAYERDIR}/recipes-*/*/*.bbappend \
    ${LAYERDIR}/recipes-*/*/*/*.bb \
    ${LAYERDIR}/recipes-*/*/*/*.bbappend \
"

BBFILE_COLLECTIONS += "syncxt"
BBFILE_PATTERN_syncxt := "^${LAYERDIR}/"
BBFILE_PRIORITY_syncxt = "9"

LICENSE_PATH += " ${LAYERDIR}/files/additional-licenses/"
```
